## v2.0.0/device_software/intel_iq_sdk/wearable_device_sw/framework/src/services/ui_service/Kconfig
```kconfig
menu "User Interface"

config UI_SERVICE_IMPL
	bool "UI service implementation"
	# depends on "HAS_XX" because we want the
	# UI service to be available only if the
	# corresponding hardware features are available
	depends on HAS_HAPTIC || HAS_LED || HAS_BUTTON
	# The board/project Kconfig must overload
	# HAPTIC/LED/BUTTON to select the right drivers
	# for the current board
	select CFW

config UI_SERVICE_IMPL_BUTTON
	bool "Button support"
	default y
	select BUTTON
	depends on HAS_BUTTON && UI_SERVICE_IMPL

config UI_SERVICE_IMPL_LED
	bool "LED support"
	default y
	select LED
	depends on HAS_LED && UI_SERVICE_IMPL

config UI_SERVICE_IMPL_HAPTIC
	bool "Haptic support"
	default y
	select HAPTIC
	depends on HAS_HAPTIC && UI_SERVICE_IMPL

config TCMD_UI_SVC
	bool "UI Service Test Command"
	depends on TCMD
	depends on UI_SERVICE_IMPL

config UI_SERVICE
	bool "UI service interface"
	select CFW

source "framework/src/lib/button/Kconfig"
source "framework/src/lib/led/Kconfig"

endmenu
```

## v2.0.0/device_software/intel_iq_sdk/wearable_device_sw/packages/intel/iq/events/Kconfig
```kconfig
menuconfig EVENTS_IQ
	bool "Events IQ"
	select COMMON_IQ
	help
	Provides feedback on internal device status to external client applications.

config USER_EVENTS_IQ
	bool "User Events IQ"
	depends on EVENTS_IQ
	select NANOPB_ENCODER
	select TOPIC_MANAGER
	select SENSING_MODULE_IQ
	select UI_SERVICE
	select LOG

config SYSTEM_EVENTS_IQ
	bool "System Events IQ"
	depends on EVENTS_IQ
	select NANOPB_ENCODER
	select TOPIC_MANAGER
	select SERVICES_QUARK_SE_STORAGE
	select SERVICES_QUARK_SE_STORAGE_CIRCULAR
	select LOG
	depends on HAS_PM_PUPDR
	select PM_PUPDR
	depends on OS_ZEPHYR
	depends on HAS_FLASH_SOC
	select SOC_FLASH
```

## v2.0.0/device_software/intel_iq_sdk/wearable_device_sw/packages/intel/iq/itm/Kconfig
```kconfig
menuconfig TOPIC_MANAGER
	bool "Topic Manager"

config TOPIC_IASP_IMPL
	bool "Topic connection over IASP"
	default y
	depends on TOPIC_MANAGER
	depends on SERVICES_BLE_IASP
```

## v2.0.0/device_software/intel_iq_sdk/wearable_device_sw/packages/intel/iq/protobuf/Kconfig
```kconfig
menu "Nanopb protobuf library"

config NANOPB_DECODER
	bool "Protobuf Decoder"
	select NANOPB_COMMON

config NANOPB_ENCODER
	bool "Protobuf Encoder"
	select NANOPB_COMMON

config NANOPB_COMMON
	bool
	help
	Common code for nanopb library

endmenu
```

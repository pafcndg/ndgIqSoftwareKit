## v2.0.0/device_software/intel_iq_sdk/wearable_device_sw/framework/src/services/Kconfig
```kconfig
source "framework/src/services/ble_service/Kconfig"
source "framework/src/services/ui_service/Kconfig"
source "framework/src/services/nfc_service/Kconfig"
source "framework/src/services/test_service/Kconfig"
source "framework/src/services/em_service/Kconfig"
source "framework/src/services/gpio_service/Kconfig"
source "framework/src/services/adc_service/Kconfig"
source "framework/src/services/ll_storage_service/Kconfig"
source "framework/src/services/properties_service/Kconfig"
source "framework/src/services/sensor_service/Kconfig"

config STORAGE_TASK
	bool
```

## v2.0.0/device_software/intel_iq_sdk/wearable_device_sw/framework/src/services/adc_service/Kconfig
```kconfig
menu "Analog Digital Converter"

config SERVICES_QUARK_SE_ADC
	bool "Client"
	select CFW

config SERVICES_QUARK_SE_ADC_IMPL
	bool "Server"
	depends on HAS_SS_ADC
	select CFW
	select SS_ADC

endmenu
```

## v2.0.0/device_software/intel_iq_sdk/wearable_device_sw/framework/src/services/ble_service/Kconfig
```kconfig
menu "BLE Service"

config SERVICES_BLE
	bool "BLE CFW based service APIs"
	select CFW
	select BLUETOOTH_PERIPHERAL

config SERVICES_BLE_IMPL
	bool "BLE CFW base service implementation"
	select CFW
	select SERVICES_BLE_GAP
	select SERVICES_BLE_GATTS
	select BLUETOOTH_PERIPHERAL

config SERVICES_BLE_GAP
	bool "BLE GAP APIs"

config SERVICES_BLE_GATTS
	bool "BLE GATT Server APIs"

config SERVICES_BLE_GATTC
	bool "BLE GATT Client APIs"
	select BLUETOOTH_GATT_CLIENT

config BLUETOOTH_GATT_CLIENT
	bool "Zephyr GATT Client implementation"

config BT_GATT_BLE_MAX_SERVICES
	int "Maximum number BLE GATT services allowed to be registered"
	default 4

config BLUETOOTH_PERIPHERAL
	bool "Bluetooth LE Peripheral API impelementation"

config BLUETOOTH_CENTRAL
	bool "Bluetooth LE Central API impelementation"

config TCMD_BLE
	bool "BLE test commands"
	depends on TCMD
	depends on SERVICES_BLE
	default y if SERVICES_BLE

config TCMD_BLE_DEBUG
	bool "BLE debug test commands"
	depends on TCMD_BLE

config SERVICES_BLE_ISPP
	bool "BLE ISPP"
	depends on SERVICES_BLE_IMPL

config SERVICES_BLE_IASP
	bool "BLE IAS"
	depends on SERVICES_BLE_ISPP
	default y if SERVICES_BLE_ISPP

config BLE_SM_IO_CAP_TEST
	bool "SM Config test commands"
	depends on TCMD_BLE
	default n

config SERVICES_BLE_BAS_USE_BAT
	bool "Use battery service to update battery level"
	depends on SERVICES_BLE_IMPL
	depends on SERVICES_QUARK_SE_BATTERY
	default y if SERVICES_QUARK_SE_BATTERY

config SERVICES_BLE_STORAGE
	bool "Use properties storage to store ble nv data"
	depends on SERVICES_BLE_IMPL
	depends on SERVICES_QUARK_SE_PROPERTIES
	default y if SERVICES_QUARK_SE_PROPERTIES

config SERVICES_BLE_CENTRAL
	bool "BLE CFW based central role APIs"
	depends on SERVICES_BLE
	select BLUETOOTH_CENTRAL

menuconfig RPC
	bool "RPC support"
	default y
	depends on IPC_UART

config RPC_OUT
	bool "Issues RPC requests"
	default y
	depends on RPC

config RPC_IN
	bool "Implements RPC requests"
	default y
	depends on RPC

source "framework/src/lib/ble/Kconfig"

endmenu
```

## v2.0.0/device_software/intel_iq_sdk/wearable_device_sw/framework/src/services/em_service/Kconfig
```kconfig
menu "Battery"

config SERVICES_QUARK_SE_BATTERY
	bool "Client"
	select CFW
	select SERVICES_QUARK_SE_PROPERTIES

config SERVICES_QUARK_SE_BATTERY_IMPL
	bool "Server"
	select CFW
	depends on HAS_USB_PM && (SOC_GPIO_AON||SOC_COMPARATOR)
	depends on HAS_BATTERY
	depends on HAS_CHARGER
	select BATTERY
	select CHARGER
	select USB_PM if HAS_USB_PM && (SOC_GPIO_AON||SOC_COMPARATOR)
	select SERVICES_QUARK_SE_POWER_SUPPLY
	select SERVICES_QUARK_SE_CHARGER
	select SERVICES_QUARK_SE_FUELGAUGE


source "framework/src/services/em_service/battery_LUT/Kconfig"

menu "Software drivers"

config SERVICES_QUARK_SE_CHARGER
	bool "Charging Service"
	select SERVICES_QUARK_SE_GPIO

choice
	prompt "Charger"
	default BQ25101H
	depends on SERVICES_QUARK_SE_CHARGER
	help
	Pick the Charger driver according to your hardware/battery specification.

config QUARK_CHARGER
	bool "Internal charger driver for BQ25101H"
	help
	Enable SoC charger driver.

config BQ25120
	bool "External charger driver for BQ25120"
	select INTEL_QRK_I2C
	help
	Enable external charger driver.

endchoice

config HAS_CHARGER
	bool

config CHARGER
	bool "Charger feature"
	default y if HAS_CHARGER
	help
	Enable the Charger

config HAS_WC_CHARGER
	bool

config WC_CHARGER
	bool "Wireless Charging feature"
	default y if HAS_WC_CHARGER
	help
	Enable the Wireless Charging

config QI_BQ51003
	bool "QI charging driver for BQ51003"
	depends on SERVICES_QUARK_SE_CHARGER
	help
	Enable the wireless charging feature for QI standard.

config HAS_WIRED_CHARGER
	bool

config WIRED_CHARGER
	bool "Wired Charging feature"
	default y if HAS_WIRED_CHARGER
	help
	Enable the WIRED Charging

config USB_POWER_SUPPLY
	bool "USB charging driver"
	depends on SERVICES_QUARK_SE_CHARGER
	depends on USB_PM

config SERVICES_QUARK_SE_FUELGAUGE
	bool "Fuel gauge"
	select SERVICES_QUARK_SE_ADC
	select SERVICES_QUARK_SE_GPIO
	select SERVICES_QUARK_SE_CHARGER

config BATT_ADC_FACTOR
	int "Battery ADC factor"
	default 124 if BOARD_CURIE_CRB || BOARD_CURIE_ORB
	default 110
	depends on SERVICES_QUARK_SE_FUELGAUGE

config FG_USE_SS_GPIO
	bool
	default y
	depends on SERVICES_QUARK_SE_FUELGAUGE

config FG_EN_GPIO_ID
	int "GPIO Index for FG Enable pin"
	default 14
	depends on SERVICES_QUARK_SE_FUELGAUGE

endmenu

endmenu
```

## v2.0.0/device_software/intel_iq_sdk/wearable_device_sw/framework/src/services/em_service/battery_LUT/Kconfig
```kconfig
menu "LUT"

choice
	prompt "Battery LUT"
	default CUSTOM_LUT
	depends on SERVICES_QUARK_SE_BATTERY_IMPL
	help
	Pick the LUT according to your hardware/battery specification.

config CUSTOM_LUT
	bool "LUT for Custom battery "

config FG_LUT_P0469
	bool "LUT for P0469LF CRB battery "

config FG_LUT_FC_SYNERGY2
	bool "LUT for FCSYNERGY2 battery"

endchoice

endmenu
```

## v2.0.0/device_software/intel_iq_sdk/wearable_device_sw/framework/src/services/gpio_service/Kconfig
```kconfig
menu "GPIO"

config SERVICES_QUARK_SE_GPIO
	bool "Quark SE GPIO service client"
	select CFW

config SERVICES_QUARK_SE_GPIO_IMPL
	bool "Quark SE GPIO service server"
	depends on HAS_GPIO
	select CFW
	select SOC_GPIO if HAS_GPIO_SOC
	select SS_GPIO if HAS_GPIO_SS

endmenu
```

## v2.0.0/device_software/intel_iq_sdk/wearable_device_sw/framework/src/services/ll_storage_service/Kconfig
```kconfig
if QUARK_SE_QUARK

menu "Low level storage"

config SERVICES_QUARK_SE_STORAGE
	bool "Client"
	select CFW

config SERVICES_QUARK_SE_STORAGE_IMPL
	bool "Server"
	depends on HAS_FLASH
	select CFW
	select STORAGE_TASK
	select SOC_FLASH if HAS_FLASH_SOC
	select SPI_FLASH if HAS_SPI_FLASH

config SERVICES_QUARK_SE_STORAGE_CIRCULAR
	bool "Circular storage"
	depends on HAS_SPI_FLASH
	select CSTORAGE_FLASH_SPI

endmenu

endif
```

## v2.0.0/device_software/intel_iq_sdk/wearable_device_sw/framework/src/services/nfc_service/Kconfig
```kconfig
menu "NFC Service"

config NFC_SERVICE_IMPL
    bool "NFC service implementation"
    select CFW

config NFC_SERVICE
    bool "NFC service interface"
    select CFW

endmenu
```

## v2.0.0/device_software/intel_iq_sdk/wearable_device_sw/framework/src/services/properties_service/Kconfig
```kconfig
menu "Properties"

config SERVICES_QUARK_SE_PROPERTIES
	bool "Client"
	select CFW

config SERVICES_QUARK_SE_PROPERTIES_IMPL
	bool "Server"
	select CFW
	select STORAGE_TASK
	select QUARK_SE_PROPERTIES_STORAGE

config TCMD_SERVICES_QUARK_SE_PROPERTIES
	bool "Test command"
	depends on TCMD
	depends on SERVICES_QUARK_SE_PROPERTIES_IMPL

endmenu
```

## v2.0.0/device_software/intel_iq_sdk/wearable_device_sw/framework/src/services/sensor_service/Kconfig
```kconfig
menu "Sensors"

config SERVICES_SENSOR
	bool "Client"
	select CFW

config SERVICES_SENSOR_IMPL
	bool "Server"
	depends on HAS_BMI160
	select CFW
	select SERVICES_QUARK_SE_PROPERTIES
	select BMI160
	select SENSOR_CORE

config SENSOR_CORE
	bool

if SENSOR_CORE

config SENSOR_CORE_ALGO_COMMON
	bool

menu "Sensor Core Algorithms"

config SENSOR_CORE_ALGO_UDG
	bool "User Defined Gesture"
	depends on HAS_PATTERN_MATCHING
	select SENSOR_CORE_ALGO_COMMON
	select PATTERN_MATCHING_DRV

config SENSOR_CORE_ALGO_TAPPING
	bool "Tapping"
	select SENSOR_CORE_ALGO_COMMON

config SENSOR_CORE_ALGO_SIMPLEGES
	bool "Simple Gesture"
	select SENSOR_CORE_ALGO_COMMON

config SENSOR_CORE_ALGO_STEPCOUNTER_ACTIVITY
	bool "Step counter and Activity classification"
	select SENSOR_CORE_ALGO_COMMON

config SENSOR_CORE_ALGO_BIKE
	bool "Biking"
	depends on SENSOR_CORE_ALGO_STEPCOUNTER_ACTIVITY
	select SENSOR_CORE_ALGO_COMMON

config SENSOR_CORE_ALGO_DEMO
	bool "Algo Demo"
	select SENSOR_CORE_ALGO_COMMON
endmenu

endif

endmenu
```

## v2.0.0/device_software/intel_iq_sdk/wearable_device_sw/framework/src/services/test_service/Kconfig
```kconfig
menu "Test services"

config CFW_TEST_SERVICE_IMPL
	bool "Test service implementation"
	select CFW

config CFW_TEST_SERVICE
	bool "Test service interface"
	select CFW

endmenu
```

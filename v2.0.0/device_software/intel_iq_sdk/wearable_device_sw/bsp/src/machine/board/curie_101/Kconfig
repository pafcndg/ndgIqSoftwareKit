## v2.0.0/device_software/intel_iq_sdk/wearable_device_sw/bsp/src/machine/board/curie_101/Kconfig
```kconfig
config BOARD_CURIE_101
	bool "Curie_101"
	# This board contains the Curie Module
	select CURIE
	select HAS_BUTTON
	select HAS_LED
	# It also has an SPI Flash
	select HAS_SPI_FLASH
	# Use the SPI Flash through the W25Q16DV driver
	select SPI_FLASH_W25Q16DV if SPI_FLASH

if BOARD_CURIE_101

# Here we set all flags that are common to all derivatives for this board

# We use the same machine headers as the Curie Test Board
config MACHINE_INCLUDE_PATH
	string
	default     "$(T)/bsp/include/machine/board/curie_ctb/$(CONFIG_CORE_NAME)/"

# Override the USB Product ID
config USB_PRODUCT_ID
	hex
	default 0x0AB6

config USB_VENDOR_ID
	hex
	default 0x8087

config CURIE_101_NO_DEBUG_PRINTS
	bool "Disable debug prints on serial port on pins 0/1 of Arduino header"
	default 1

config LED
	# Overwrite LED flag to resolve LED driver dependencies
	# (select the right LED device and I2C bus)
	select GPIO_LED

config BUTTON
	# Overwrite BUTTON flag to resolve button driver dependencies
	# (button driver is based on gpio service on CRB hardware)
	select BUTTON_GPIO_SVC

# Curie module is safe to stay on the external oscillator when USB is unplugged
config QUARK_SE_SWITCH_INTERNAL_OSCILLATOR
	bool
	default n
endif
```

## v2.0.0/device_software/intel_iq_sdk/wearable_device_sw/bsp/src/machine/board/curie_app/Kconfig
```kconfig
config BOARD_CURIE_APP
	bool "AtlasPeak Platform (APP)"
	# List all available hardware for this board
	select QUARK_SE
	select HAS_BLE_CORE
	select HAS_SPI_FLASH if QUARK
	select HAS_LED if QUARK
	select HAS_HAPTIC if QUARK
	# Select appropriate driver if a feature is activated
	select SPI_FLASH_MX25U12835F if (SPI_FLASH && QUARK)
	select HAS_BME280_SPI

if BOARD_CURIE_APP

# Set the default for this option, which is already defined in the Kconfig above
config MACHINE_INCLUDE_PATH
	string
	default     "$(T)/bsp/include/machine/board/curie_ctb/$(CONFIG_CORE_NAME)/"

config BATT_ADC_FACTOR
        int "Battery ADC factor"
	default 110

config FG_USE_SS_GPIO
        bool "Fuel gauge SS gpio usage"
        default y

config FG_EN_GPIO_ID
	int "GPIO Index for FG Enable pin"
	default 14

endif
```

## v2.0.0/device_software/intel_iq_sdk/wearable_device_sw/bsp/src/machine/board/curie_crb/Kconfig
```kconfig
config BOARD_CURIE_CRB
	bool "Curie Customer Reference Board (CRB)"
	select CURIE
	select HAS_HAPTIC
	select HAS_BUTTON
	select HAS_LED
	select HAS_SPI_FLASH
	select HAS_WC_CHARGER if QUARK
	select HAS_WIRED_CHARGER if QUARK
	# Select appropriate driver if a feature is activated
	select SPI_FLASH_MX25U12835F if (SPI_FLASH && QUARK)
	select HAS_BOARD_SHUTDOWN
	select QI_BQ51003 if (WC_CHARGER && SERVICES_QUARK_SE_CHARGER)
	select USB_POWER_SUPPLY if (WIRED_CHARGER && SERVICES_QUARK_SE_CHARGER)
	select QUARK_CHARGER if (CHARGER && SERVICES_QUARK_SE_CHARGER)
	select HAS_BME280_I2C

if BOARD_CURIE_CRB

# Set the default for this option, which is already defined in the Kconfig above
config MACHINE_INCLUDE_PATH
	string
	default "$(T)/bsp/include/machine/board/curie_ctb/$(CONFIG_CORE_NAME)/"

# crb module is safe to stay on the external oscillator when usb is unplugged
config QUARK_SE_SWITCH_INTERNAL_OSCILLATOR
	bool
	default n

config LED
	# Overwrite LED flag to resolve LED driver dependencies
	# (select the right LED device and I2C bus)
	select LP5562_LED
	select INTEL_QRK_I2C

config BUTTON
	# Overwrite BUTTON flag to resolve button driver dependencies
	# (button driver is based on gpio service on CRB hardware)
	select BUTTON_GPIO_SVC

config HAPTIC
	# Overwrite HAPTIC flag to resolve haptic driver dependencies
	select DRV2605
	select INTEL_QRK_I2C

config BATT_ADC_FACTOR
        int "Battery ADC factor"
	default 124

config FG_USE_SS_GPIO
        bool "Fuel gauge SS gpio usage"
        default y

config FG_EN_GPIO_ID
	int "GPIO Index for FG Enable pin"
	default 14

endif
```

## v2.0.0/device_software/intel_iq_sdk/wearable_device_sw/bsp/src/machine/board/curie_ctb/Kconfig
```kconfig
config BOARD_CURIE_CTB
	bool "Curie Test Board (CTB)"
	select CURIE

if BOARD_CURIE_CTB

# Set the default for this option, which is already defined in the Kconfig above
config MACHINE_INCLUDE_PATH
	string
	default     "$(T)/bsp/include/machine/board/curie_ctb/$(CONFIG_CORE_NAME)/"

# internal regulators are used in ctb board
config QUARK_SE_DISABLE_INTERNAL_VREG
	bool
	default n

config BATT_ADC_FACTOR
        int "Battery ADC factor"
	default 110

config FG_USE_SS_GPIO
        bool "Fuel gauge SS gpio usage"
        default y

config FG_EN_GPIO_ID
	int "GPIO Index for FG Enable pin"
	default 14

endif
```

## v2.0.0/device_software/intel_iq_sdk/wearable_device_sw/bsp/src/machine/board/curie_orb/Kconfig
```kconfig
config BOARD_CURIE_ORB
	bool "Intel Curie ORB"
	select CURIE
	# Select appropriate driver if a feature is activated
	select HAS_BUTTON
	select HAS_LED
	select HAS_SPI_FLASH
	select HAS_WIRED_CHARGER if QUARK
	select SPI_FLASH_MX25R1635F if (SPI_FLASH && QUARK)
	select USB_POWER_SUPPLY if (WIRED_CHARGER && SERVICES_QUARK_SE_CHARGER)
	select QUARK_CHARGER if (CHARGER && SERVICES_QUARK_SE_CHARGER)

if BOARD_CURIE_ORB

# Set the default for this option, which is already defined in the Kconfig above
config MACHINE_INCLUDE_PATH
	string
	default "$(T)/bsp/include/machine/board/curie_ctb/$(CONFIG_CORE_NAME)/"

# orb module is safe to stay on the external oscillator when usb is unplugged
config QUARK_SE_SWITCH_INTERNAL_OSCILLATOR
	bool
	default n

config LED
	# Overwrite LED flag to resolve LED driver dependencies
	# (select the right LED device and I2C bus)
	select LP5562_LED
	select INTEL_QRK_I2C

config BUTTON
	# Overwrite BUTTON flag to resolve button driver dependencies
	# (button driver is based on gpio service on ORB hardware)
	select BUTTON_GPIO_SVC

config BATT_ADC_FACTOR
	int "Battery ADC factor"
	default 124

config FG_USE_SS_GPIO
	bool "Fuel gauge SS gpio usage"
	default y

config FG_EN_GPIO_ID
	int "GPIO Index for FG Enable pin"
	default 14

endif
```

## v2.0.0/device_software/intel_iq_sdk/wearable_device_sw/bsp/src/machine/board/morpheus/Kconfig
```kconfig
config BOARD_MORPHEUS
	bool "Curie Morpheus Board (CMB)"
	select CURIE

if BOARD_MORPHEUS

# Set the default for this option, which is already defined in the Kconfig above
config MACHINE_INCLUDE_PATH
	string
	default "$(T)/bsp/include/machine/board/curie_ctb/$(CONFIG_CORE_NAME)/"

config BATT_ADC_FACTOR
        int "Battery ADC factor"
	default 124

config FG_USE_SS_GPIO
        bool "Fuel gauge SS gpio usage"
        default y

config FG_EN_GPIO_ID
	int "GPIO Index for FG Enable pin"
	default 14

endif
```

## v2.0.0/device_software/intel_iq_sdk/wearable_device_sw/bsp/src/machine/generic/linux-test-fw/Kconfig
```kconfig
menu "Linux test fw"

config HOST_TEST_FW
	bool "Linux test fw"
	help
	Linux remote test framework

endmenu
```

## v2.0.0/device_software/intel_iq_sdk/wearable_device_sw/bsp/src/machine/generic/linux-test-fw/defconfig
```kconfig
CONFIG_CFW=y
CONFIG_QUARK_SE=y
CONFIG_CURIE_CTB=y
CONFIG_SERVICES_QUARK_SE_BATTERY=y
CONFIG_SERVICES_QUARK_SE_PROPERTIES=y
CONFIG_SERVICES_QUARK_SE_STORAGE=y
CONFIG_SERVICES_QUARK_SE_GPIO=y
CONFIG_SERVICES_QUARK_SE_ADC=y
CONFIG_CFW_SERVICES_TEST=y
CONFIG_CFW_TEST_SERVICE=y
CONFIG_CFW_CLIENT=y
CONFIG_CFW_SERVICE=y
CONFIG_UI_SERVICE=y
CONFIG_OS_LINUX=y
CONFIG_LIST=y
CONFIG_INFRA=y
CONFIG_LOG=y
CONFIG_LOG_PRINTK=y
CONFIG_HOST_TEST_FW=y
```

## v2.0.0/device_software/intel_iq_sdk/wearable_device_sw/bsp/src/machine/soc/intel/quark_se/Kconfig
```kconfig
config CURIE
	bool
	select QUARK_SE
	select HAS_BLE_CORE
	select HAS_BATTERY

config QUARK_SE_DISABLE_INTERNAL_VREG
	bool
	default y
	depends on CURIE

config QUARK_SE_SWITCH_INTERNAL_OSCILLATOR
	bool
	default y
	depends on CURIE

config QUARK_SE
	bool
	select HAS_ARC
	select HAS_QUARK

# Hardware features supported by Quark SE based platforms

# ARC | Quark
config QUARK_SE_COMMON
	bool
	depends on QUARK_SE
	default y if ARC || QUARK
	select HAS_SOC_COMPARATOR
	select HAS_GPIO_SOC_32
	select HAS_GPIO_SOC_AON
	select HAS_INTEL_QRK_I2C
	select HAS_INTEL_QRK_SPI
	select HAS_PATTERN_MATCHING
	select HAS_IPC
	select HAS_SHARED_MEM
	# select only if ble_core is available and PM is used
	# on the same core on which gpio aon is compiled
	select BLE_CORE_SUSPEND_BLOCKER_PM if PM && HAS_BLE_CORE && SOC_GPIO_AON

# ARC Only
config QUARK_SE_ARC
	bool
	depends on QUARK_SE
	default y if ARC
	select HAS_USB_PM if BOARD_CURIE_APP
	select HAS_PM_PUPDR
	select HAS_GPIO_SS
	select HAS_SS_ADC
	select HAS_SS_I2C
	select HAS_SS_SPI
	select HAS_BMI160_I2C if BOARD_CURIE_APP
	select HAS_BMI160_SPI if CURIE
	select HAS_FLOAT

# Quark Only
config QUARK_SE_QUARK
	bool
	depends on QUARK_SE
	default y if QUARK
	select HAS_IPC_UART
	select IPC_UART_NS16550 if IPC_UART
	select HAS_FLASH_SOC
	select HAS_ROM_SOC
	select HAS_USB_PM if CURIE
	select HAS_PM_PUPDR
	select HAS_INTEL_QRK_PWM
	select HAS_INTEL_QRK_RTC
	select HAS_INTEL_QRK_AON_PT
	select HAS_UART_NS16550
	select HAS_USB
	select HAS_INTEL_QRK_WDT
	select HAS_CHARGER
	# Select appropriate driver if feature is selected
	select USB_SHARED_INTERFACE if USB

# BLE Core only
config QUARK_SE_BLE_CORE
	bool
	depends on QUARK_SE
	default y if BLE_CORE
	select HAS_IPC_UART
	select BLE_LPM

menu "Quark SE"
	depends on QUARK_SE

choice
	prompt "Panic implementation"
	depends on PANIC

config QUARK_SE_PANIC_DEFAULT
	bool "Default"
	help
		Default implementation includes hardware exceptions and panic
		propagation.

config QUARK_SE_PANIC_CUSTOM
	bool "Custom"
	help
		Selecting this allows an Quark SE based project to use a different
		panic implementation.

endchoice

config QUARK_SE_PANIC_DEBUG
	bool "Panic debug logs"
	default y
	depends on QUARK_SE_PANIC_DEFAULT
	help
		Parse and print panic dumps for ARC/QRK cores before reset.

config QUARK_SE_PINMUX_SETUP
	bool "Pinmux Setup"
	default y if QUARK_SE_QUARK
	depends on QUARK_SE
	help
		Provides the default pinmux configuration for Quark SE. You
		should call pinmux_config() to setup the pinmux.
		Note that Quark boots first, so it is better if that is the
		core that implements this functionality.

config QUARK_SE_USB_SETUP
	bool "Quark SE specific USB initialization"
	default y
	depends on QUARK_SE
	depends on USB
	depends on SOC_GPIO_32
	help
		Provides USB platform initialization for Quark SE.

config QUARK_SE_UPTIME
	bool "Quark SE uptime implementation"
	default y
	depends on QUARK_SE
	help
		Provides an implementation for get_uptime_32k() and
		get_uptime() for Quark SE platform.

config OS_ZEPHYR_LIBC_HOOKS
	bool "LibC Hooks for Zephyr's LibC"
	default y
	depends on OS_ZEPHYR_MICROKERNEL
	help
		Provides basic stubs implementations for kill, getpid and sbrk
		functions needed by Zephyr's LibC.

config QUARK_SE_ARC_STARTUP_DISABLED
	bool "Debug ARC startup with GDB"
	depends on QUARK_SE
	help
		In order to be able to debug ARC startup, you need to connect to it with gdb before
		the core starts. Selecting this option will prevent Quark to start the ARC processor,
		allowing the debugger to do that manually.
		NOTE: this should only be done for debugging sessions when debugging ARC startup.

menu "Memory mapping"

config QUARK_SE_ARC_RAM_SIZE
	hex "ARC RAM size"
	default 0x6000

config QUARK_SE_ARC_DCCM_SIZE
	hex "DCCM RAM size"
	default 0x2000

endmenu

if QUARK_SE_QUARK
menu "Quark SE Quark"

config QUARK_SE_QUARK_INT_STUBS
	bool "Interrupt Table for Quark on Zephyr"
	default y
	depends on OS_ZEPHYR
	depends on QUARK_SE_QUARK
	help
		Provides static interrupt table.

config QUARK_SE_QUARK_LOG_BACKEND_UART
	bool "UART log backend for Quark on Zephyr"
	default y
	depends on OS_ZEPHYR
	depends on QUARK_SE_QUARK
	help
		Provides a logger backend that uses UART1.

config QUARK_SE_PROPERTIES_STORAGE
	bool "Properties storage implementation for Quark SE"
	depends on QUARK_SE_QUARK
	depends on HAS_FLASH_SOC
	select SOC_FLASH
	help
		It is based on the internal Quark SE Flash

config QUARK_SE_QUARK_SOC_SETUP
	bool "SoC Initialization for Quark on Zephyr"
	default y
	depends on QUARK_SE_QUARK_INT_STUBS
	depends on OS_ZEPHYR
	depends on QUARK_SE_QUARK
	help
		Provides SoC initialization.

config QUARK_SE_QUARK_SOC_CONFIG
	bool "SoC configuration for Quark"
	default y
	depends on QUARK_SE_QUARK
	depends on DEVICE_FRAMEWORK
	help
		Device tree implementation as seen on Quark SE by Quark
		core. Provides a function called init_all_devices() to
		initialize the statically compiled device tree.

config DEEPSLEEP
	bool "Allow deep sleep in QUARK core"
	depends on HAS_INTEL_QRK_AON_PT
	depends on PM_PUPDR
	depends on OS_ZEPHYR
	select INTEL_QRK_AON_PT

endmenu
endif

if QUARK_SE_ARC
menu "Quark SE Arc"

config QUARK_SE_ARC_SOC_SETUP
	bool "SoC Initialization for ARC on Zephyr"
	default y
	depends on OS_ZEPHYR
	depends on QUARK_SE_ARC
	help
		Provides SoC initialization.

config QUARK_SE_ARC_SOC_CONFIG
	bool "SoC configuration for ARC"
	default y
	depends on QUARK_SE_ARC
	depends on DEVICE_FRAMEWORK
	help
		Device tree implementation as seen on Quark SE by ARC core.
		Provides a function called init_all_devices() to initialize the
		statically compiled device tree.

config DEEPSLEEP
	bool "Allow deep sleep in ARC core"
	depends on PM_PUPDR
	depends on OS_ZEPHYR

endmenu
endif

endmenu
```

## v2.0.0/device_software/intel_iq_sdk/wearable_device_sw/bsp/src/util/Kconfig
```kconfig
menu "Utility libraries"

config WORKQUEUE
	bool "An OS agnostic workqueue implementation"
	select LOG

config CUNIT_TESTS
	bool "Unit Tests Utils"
	select LOG

config LIST
	bool "Generic list handler"

menu "Flash circular storage"
	depends on HAS_SPI_FLASH || HAS_FLASH_SOC

config CSTORAGE_FLASH
	bool

config CSTORAGE_FLASH_SPI
	bool "SPI Flash circular storage"
	depends on HAS_SPI_FLASH
	select CSTORAGE_FLASH
	select SPI_FLASH

endmenu

endmenu
```

## v2.0.0/device_software/intel_iq_sdk/wearable_device_sw/framework/src/lib/ble/Kconfig
```kconfig
config BLE_APP
	bool "BLE Reference application implementation"
	depends on CFW
	depends on SERVICES_BLE
	depends on SERVICES_BLE_IMPL
	depends on IPC_UART_NS16550
	depends on SERVICES_QUARK_SE_PROPERTIES
```

## v2.0.0/device_software/intel_iq_sdk/wearable_device_sw/framework/src/lib/button/Kconfig
```kconfig
config HAS_BUTTON
	bool
	help
	This feature should be selected automatically if the board
	has a built-in LED support. It can also be selected
	by the project Kconfig in case of customized hardware.

menu "Buttons"

	depends on HAS_BUTTON

config BUTTON
	bool
	depends on HAS_BUTTON
	help
	This flag is used to resolve the dependencies
	of the button driver for a specific hardware.
	This flag must be overwritten in the board Kconfig

config BUTTON_LIB
	bool
	help
	This flag is used to compile the button generic lib

config BUTTON_GPIO_SVC
	bool "Button wrapper based on gpio service"
	depends on HAS_BUTTON
	select SERVICES_QUARK_SE_GPIO
	select BUTTON_LIB
	help
	Button wrapper based on gpio service

config BUTTON_MULTIPLE_PRESS
	bool "Notify when several buttons are pressed in the same time"
	depends on BUTTON_LIB
	help
	Send a MULTIPLE_PRESS notification if several buttons are pressed
	in the same time

config BUTTON_FEEDBACK
	bool "Feedback between button actions"
	depends on BUTTON_LIB
	help
	Send a feedback notification between button timing based actions
endmenu
```

## v2.0.0/device_software/intel_iq_sdk/wearable_device_sw/framework/src/lib/led/Kconfig
```kconfig
menu "LED"

config GPIO_LED
    bool "Simple LED based on gpio service"
    depends on HAS_LED
    select SERVICES_QUARK_SE_GPIO

endmenu
```

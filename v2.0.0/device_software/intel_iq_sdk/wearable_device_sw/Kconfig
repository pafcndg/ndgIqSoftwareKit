## v2.0.0/device_software/intel_iq_sdk/wearable_device_sw/bsp/src/drivers/wdt/Kconfig
```kconfig
config WDT
	bool

config HAS_INTEL_QRK_WDT
	bool

config INTEL_QRK_WDT
	bool "Intel Quark WDT driver"
	depends on HAS_INTEL_QRK_WDT
	select WDT
	select CLK_SYSTEM

config TCMD_WDT
	bool "WDT Test Command"
	depends on TCMD
	depends on INTEL_QRK_WDT

if INTEL_QRK_WDT

menu "WDT routed as NMI"

config WDT_NMI
	bool "WDT NMI"
	help
		Routes the WDT interrupt as NMI
	depends on INTEL_QRK_WDT

endmenu

endif
```

## v2.0.0/device_software/intel_iq_sdk/wearable_device_sw/bsp/src/infra/tcmd/Kconfig
```kconfig
menuconfig TCMD
	bool "Test Commands"
	help
	Test Commands allow specific features of the target to be tested by sending
	ASCII formatted buffers on a communication interface like UART.

if TCMD

config TCMD_ASYNC
	bool "Asynchronous Mode"
	help
	Asynchronous Test Command support based on basic messaging.

config TCMD_CONSOLE_USB_ACM
	bool "Test commands on CDC_ACM"
	depends on USB_ACM

config TCMD_CONSOLE
	bool "Basic console client"
	select TCMD_ASYNC

choice
	prompt "Master/Slave"
	optional

config TCMD_MASTER
	bool "Master"
	select TCMD_ASYNC
	select IPC
	select LIST
	help
	Master Mode allows a node to dispatch Test Commands to slave nodes.

config TCMD_SLAVE
	bool "Slave"
	select TCMD_ASYNC
	help
	Slave Mode allows a node to handle Test Commands received on a master node.

endchoice

endif
```

## v2.0.0/device_software/intel_iq_sdk/wearable_device_sw/bsp/src/machine/Kconfig
```kconfig
config MACHINE_INCLUDE_PATH
	string
	help
		The directory where the mandatory machine.h file for this machine is
		located. It is automatically added to the include search path.

# Board selection
source "bsp/src/machine/board/Kconfig"

# SoC features (can only be selected automatically by the board)
source "bsp/src/machine/soc/intel/quark_se/Kconfig"

config HAS_FLOAT
	bool

config HAS_ARC
	bool

config HAS_QUARK
	bool

config HAS_BLE_CORE
	bool
	select HAS_IPC

choice
	prompt "Core"
	depends on HAS_ARC || HAS_QUARK || HAS_BLE_CORE

config ARC
	bool "ARC"
	depends on HAS_ARC

config QUARK
	bool "Quark"
	depends on HAS_QUARK

config BLE_CORE
	bool "BLE Core"
	depends on HAS_BLE_CORE

endchoice

config BLE_LPM
	bool "BLE Low Power Mode"
	depends on BLE_CORE

config CORE_NAME
	string
	default "arc" if ARC
	default "quark" if QUARK
	default "ble_core" if BLE_CORE

config RECOVERY_BOOT_TARGET
	bool
	help
		Mode to fallback when the main application mode is considered not
		functional anymore.
		It should be implemented by the board/application.

comment "Define a proper Board Configuration to enable the Core menu"
	depends on !HAS_ARC && !HAS_QUARK && !HAS_BLE_CORE
```

## v2.0.0/device_software/intel_iq_sdk/wearable_device_sw/bsp/src/machine/board/Kconfig
```kconfig
choice
	prompt "Board"

source "bsp/src/machine/board/curie_ctb/Kconfig"
source "bsp/src/machine/board/curie_app/Kconfig"
source "bsp/src/machine/board/curie_crb/Kconfig"
source "bsp/src/machine/board/curie_orb/Kconfig"
source "bsp/src/machine/board/curie_101/Kconfig"
-source "$PROJECT_PATH/boards.Kconfig"

endchoice
```

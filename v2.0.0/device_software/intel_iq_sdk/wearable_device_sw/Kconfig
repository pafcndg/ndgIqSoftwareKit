## v2.0.0/device_software/intel_iq_sdk/wearable_device_sw/Kconfig
```kconfig
mainmenu "Thunderdome build configuration"

config PROJECT_PATH
	string
	option env="PROJECT_PATH"


menu "Project"

-source "$PROJECT_PATH/project.Kconfig"

endmenu

menu "Services"

source "framework/src/services/Kconfig"
-source "$PROJECT_PATH/services.Kconfig"

endmenu

menu "Packages"

-source "packages/*/package.Kconfig"
-source "packages/*/*/package.Kconfig"

endmenu

menu "Advanced Settings"

source "bsp/Kconfig"

source "framework/Kconfig"

endmenu

menu "Debug Settings"

config OS_UNIT_TESTS
	bool "OS Unit Tests"
	help
		Caution when selecting this option, as it will dramatically
		increase the output binary size.

config QUARK_DRIVER_TESTS
	bool "Quark driver tests"

config ARC_DRIVER_TESTS
	bool "Arc driver tests"

config ARC_OS_UNIT_TESTS
	bool "Arc OS unit tests"

config GPIO_DRIVER_TESTS
	depends on GPIO
	depends on QUARK_DRIVER_TESTS || ARC_DRIVER_TESTS
	default y
	bool "GPIO driver tests"

source "bsp/src/machine/generic/linux-test-fw/Kconfig"

endmenu
```

## v2.0.0/device_software/intel_iq_sdk/wearable_device_sw/bsp/bootable/bootloader/board/intel/configs/crb_defconfig
```kconfig
CONFIG_BOARD_CURIE_CRB=y
CONFIG_BOARD_DIRECTORY="$(BOOTLOADER_ROOT)/board/intel/crb/"
CONFIG_CHIP_VENDOR_INTEL=y
CONFIG_CHIP_QUARK_SE=y
CONFIG_CORE_QUARK=y
CONFIG_X86=y
CONFIG_IOAPIC=y
CONFIG_LAPIC=y

CONFIG_CLOCK_SPEED=32000000


CONFIG_USB=y
CONFIG_USB_DEVICE=y
CONFIG_USB_DFU_VID=0x8087
CONFIG_USB_DFU_PID=0x0a99
CONFIG_USB_DFU=y

CONFIG_MISC=y
CONFIG_GPIO=y
CONFIG_DNX=y
CONFIG_SWD=y
CONFIG_DNX_TIMEOUT_S=10

# temporary implementation
CONFIG_USB_DWC_3_10B=y

# Features
CONFIG_HARDWARE_CHARGING=y
CONFIG_BATT_THRESHOLD_MV=3300
CONFIG_PANIC_DUMP=y
CONFIG_PANIC=y

CONFIG_OTA=y
CONFIG_COMP_LZG=y

CONFIG_CRYPTO=y
CONFIG_CRYPTO_SHA256=y
CONFIG_CRYPTO_ECDSA=y

CONFIG_SECURE_BOOT=y
CONFIG_SECURE_UPDATE=y
CONFIG_SIGNATURE_HEADER_SIZE=0x80

# Hardware
# CONFIG_INTERRUPT_MODE is not set
# CONFIG_TIMER is not set
# CONFIG_SERIAL is not set
# CONFIG_RTC is not set
# CONFIG_WATCHDOG is not set
CONFIG_SPI=y
CONFIG_SPI_MASTER=SPI_0
CONFIG_MTD=y
CONFIG_SPI_FLASH=y
CONFIG_SPI_FLASH_MX25U12835F=y
CONFIG_SPI_FLASH_MX25=y
CONFIG_CACHE_PARTITION=y
# CONFIG_I2C is not set
```

## v2.0.0/device_software/intel_iq_sdk/wearable_device_sw/bsp/bootable/bootloader/board/intel/configs/ctb_defconfig
```kconfig
CONFIG_BOARD_CURIE_CTB=y
CONFIG_BOARD_DIRECTORY="$(BOOTLOADER_ROOT)/board/intel/ctb/"
CONFIG_CHIP_VENDOR_INTEL=y
CONFIG_CHIP_QUARK_SE=y
CONFIG_CORE_QUARK=y
CONFIG_X86=y
CONFIG_IOAPIC=y
CONFIG_LAPIC=y


CONFIG_USB=y
CONFIG_USB_DEVICE=y
CONFIG_USB_DFU_VID=0x8087
CONFIG_USB_DFU_PID=0x0a99
CONFIG_USB_DFU=y

CONFIG_QUARK_SE_SWITCH_INTERNAL_OSCILLATOR=y

CONFIG_MISC=y
CONFIG_GPIO=y
CONFIG_DNX=y
CONFIG_SWD=y
CONFIG_DNX_TIMEOUT_S=10

# temporary implementation
CONFIG_USB_DWC_3_10B=y

# Features
CONFIG_PANIC_DUMP=y
CONFIG_PANIC=y

CONFIG_CRYPTO=y
CONFIG_CRYPTO_SHA256=y
CONFIG_CRYPTO_ECDSA=y

CONFIG_SECURE_BOOT=y
CONFIG_SECURE_UPDATE=y
CONFIG_SIGNATURE_HEADER_SIZE=0x80

# Hardware
# CONFIG_INTERRUPT_MODE is not set
# CONFIG_TIMER is not set
# CONFIG_SERIAL is not set
# CONFIG_RTC is not set
# CONFIG_WATCHDOG is not set
# CONFIG_SPI is not set
# CONFIG_I2C is not set
```

## v2.0.0/device_software/intel_iq_sdk/wearable_device_sw/bsp/bootable/bootloader/board/intel/configs/curie_101_defconfig
```kconfig
CONFIG_BOARD_CURIE_101=y
CONFIG_BOARD_DIRECTORY="$(BOOTLOADER_ROOT)/board/intel/curie_101/"
CONFIG_CHIP_VENDOR_INTEL=y
CONFIG_CHIP_QUARK_SE=y
CONFIG_CORE_QUARK=y
CONFIG_X86=y
CONFIG_IOAPIC=y
CONFIG_LAPIC=y


CONFIG_USB=y
CONFIG_USB_DEVICE=y
CONFIG_USB_DFU_VID=0x8087
CONFIG_USB_DFU_PID=0x0ABA
CONFIG_USB_DFU=y

# CONFIG_QUARK_SE_SWITCH_INTERNAL_OSCILLATOR is not set

CONFIG_MISC=y
CONFIG_GPIO=y
CONFIG_DNX=y
CONFIG_SWD=y
CONFIG_DNX_TIMEOUT_S=5

# temporary implementation
CONFIG_USB_DWC_3_10B=y

# Features
#define CONFIG_PANIC_DUMP is not set
#define CONFIG_PANIC is not set

CONFIG_CRYPTO=y
CONFIG_CRYPTO_SHA256=y
CONFIG_CRYPTO_ECDSA=y

CONFIG_SECURE_BOOT=y
CONFIG_SECURE_UPDATE=y
CONFIG_SIGNATURE_HEADER_SIZE=0x80

# Hardware
# CONFIG_INTERRUPT_MODE is not set
# CONFIG_TIMER is not set
# CONFIG_SERIAL is not set
# CONFIG_RTC is not set
# CONFIG_WATCHDOG is not set
# CONFIG_SPI is not set
# CONFIG_I2C is not set
```

## v2.0.0/device_software/intel_iq_sdk/wearable_device_sw/bsp/bootable/bootloader/drivers/Kconfig
```kconfig
menu "Device Drivers"

source "drivers/misc/Kconfig"
source "drivers/usb/Kconfig"
source "drivers/mtd/Kconfig"

endmenu
```

## v2.0.0/device_software/intel_iq_sdk/wearable_device_sw/bsp/bootable/bootloader/drivers/mtd/Kconfig
```kconfig
config SPI_FLASH
	bool

config SPI_FLASH_W25Q16DV
	bool "SPI NOR Flash Winbond W25Q16DV on Intel QRK"
	select SPI_FLASH

config SPI_FLASH_MX25U12835F
	bool "SPI NOR Flash Macronix MX25U12835F on Intel QRK"
	select SPI_FLASH
	select SPI_MX25

config SPI_FLASH_MX25R1635F
	bool "SPI NOR Flash Macronix MX25R1635F on Intel QRK"
	select SPI_FLASH
	select SPI_MX25
```

## v2.0.0/device_software/intel_iq_sdk/wearable_device_sw/bsp/src/drivers/Kconfig
```kconfig
menu "Drivers"

config DEVICE_FRAMEWORK
	bool
	select PM #FIXME

source "bsp/src/drivers/adc/Kconfig"
source "bsp/src/drivers/aio/Kconfig"
source "bsp/src/drivers/battery/Kconfig"
source "bsp/src/drivers/display/Kconfig"
source "bsp/src/drivers/gpio/Kconfig"
source "bsp/src/drivers/haptic/Kconfig"
source "bsp/src/drivers/led/Kconfig"
source "bsp/src/drivers/i2c/Kconfig"
source "bsp/src/drivers/ipc/Kconfig"
source "bsp/src/drivers/mtd/Kconfig"
source "bsp/src/drivers/pm/Kconfig"
source "bsp/src/drivers/pwm/Kconfig"
source "bsp/src/drivers/rtc/Kconfig"
source "bsp/src/drivers/sba/Kconfig"
source "bsp/src/drivers/sensor/Kconfig"
source "bsp/src/drivers/spi/Kconfig"
source "bsp/src/drivers/uart/Kconfig"
source "bsp/src/drivers/usb/Kconfig"
source "bsp/src/drivers/wdt/Kconfig"
source "bsp/src/drivers/clk/Kconfig"
source "bsp/src/drivers/nfc/Kconfig"
source "bsp/src/drivers/fs/Kconfig"
-source "$PROJECT_PATH/drivers.Kconfig"

endmenu
```

## v2.0.0/device_software/intel_iq_sdk/wearable_device_sw/bsp/src/drivers/adc/Kconfig
```kconfig
config ADC
	bool

config HAS_SS_ADC
	bool

config SS_ADC
	bool "SS ADC driver"
	depends on HAS_SS_ADC
	select ADC
	select CLK_SYSTEM
	select WAKELOCK
```

## v2.0.0/device_software/intel_iq_sdk/wearable_device_sw/bsp/src/drivers/battery/Kconfig
```kconfig
config BATTERY
	bool
	depends on HAS_BATTERY

config HAS_BATTERY
	bool "Battery"
	help
	This feature should be selected automatically if the board
	has a built-in battery, but can also be specified manually
	in case of customized hardware.
```

## v2.0.0/device_software/intel_iq_sdk/wearable_device_sw/bsp/src/drivers/display/Kconfig
```kconfig
config DISPLAY_HD44780
	bool "HD44780 display driver"
	depends on HAS_GPIO_SOC_32
	select SOC_GPIO
	select SOC_GPIO_32
	select DEVICE_FRAMEWORK
```

## v2.0.0/device_software/intel_iq_sdk/wearable_device_sw/bsp/src/drivers/fs/Kconfig
```kconfig
config FAT_FS
	bool "Enable FAT Filesystem Disk IO"
	default n
	depends on SPI_FLASH_INTEL_QRK
	help
	Enable FAT filesystem disk IO.
```

## v2.0.0/device_software/intel_iq_sdk/wearable_device_sw/bsp/src/drivers/haptic/Kconfig
```kconfig
config HAS_HAPTIC
	bool
	help
	This feature should be selected automatically if the board
	has a built-in Haptic support. It can also be selected
	by the project Kconfig in case of customized hardware.

menu "Haptic"

	depends on HAS_HAPTIC

config HAPTIC
	bool
	help
	This flag is used to resolve the dependencies
	of the haptic driver for a specific hardware.
	This flag must be overwritten in the board Kconfig

config DRV2605
	bool "DRV2605 Haptic driver"
	depends on HAS_INTEL_QRK_I2C
	select I2C
	select WAKELOCK
	select DEVICE_FRAMEWORK

endmenu
```

## v2.0.0/device_software/intel_iq_sdk/wearable_device_sw/bsp/src/drivers/i2c/Kconfig
```kconfig
config I2C
	bool

config HAS_INTEL_QRK_I2C
	bool

config INTEL_QRK_I2C
	bool "Intel Quark I2C driver"
	depends on HAS_INTEL_QRK_I2C
	select I2C
	select SBA if TCMD
	select CLK_SYSTEM

config HAS_SS_I2C
	bool

config SS_I2C
	bool "SS I2C driver"
	depends on HAS_SS_I2C
	select I2C
	select SBA if TCMD
	select CLK_SYSTEM
```

## v2.0.0/device_software/intel_iq_sdk/wearable_device_sw/bsp/src/drivers/ipc/Kconfig
```kconfig
config HAS_IPC_UART
	bool

config IPC_UART
	bool "UART IPC link"
	depends on HAS_IPC_UART
	depends on HAS_GPIO_SOC_32 || BLE_CORE
	select GPIO_SOC_32 if HAS_GPIO_SOC_32

config IPC_UART_NS16550
	bool "UART NS16550 IPC link driver"
	depends on HAS_IPC_UART
	depends on OS_ZEPHYR
	select WAKELOCK

config IPC_UART_BAUDRATE
	int "IPC UART Baudrate"
	default 115200
	depends on IPC_UART
```

## v2.0.0/device_software/intel_iq_sdk/wearable_device_sw/bsp/src/drivers/led/Kconfig
```kconfig
config HAS_LED
	bool
	help
	This feature should be selected automatically if the board
	has a built-in LED support. It can also be selected
	by the project Kconfig in case of customized hardware.

menu "LED"

	depends on HAS_LED

config LED
	bool
	help
	This flag is used to resolve the dependencies
	of the led driver for a specific hardware.
	This flag must be overwritten in the board Kconfig

config LED_MULTICOLOR
	bool

config SOC_LED
	bool "SOC Led driver"
	# Change Quark driver dependency when a generic PWM driver API is defined
	depends on HAS_INTEL_QRK_PWM
	select INTEL_QRK_PWM
	select DEVICE_FRAMEWORK
	select WAKELOCK

config LP5562_LED
	bool "LP5562 Led driver"
	depends on HAS_INTEL_QRK_I2C
	select I2C
	select DEVICE_FRAMEWORK
	select LED_MULTICOLOR

config LED_WAVE_SUPPORT
	bool "Led wave support"
	depends on LP5562_LED

choice
       depends on LP5562_LED
       prompt "LP5562 LED type"
       config LP_5562_LED_C113
       bool "C113"
       config LP_5562_LED_C115
       bool "C115"
       config LP_5562_LED_LX404
       bool "LX404"
       config LP_5562_LED_SMLP34
       bool "SMLP34"
endchoice

endmenu
```

## v2.0.0/device_software/intel_iq_sdk/wearable_device_sw/bsp/src/drivers/nfc/Kconfig
```kconfig
config NFC
	bool

config NFC_STN54E
	bool "STN54E NFC chip on Intel QRK"
	depends on HAS_INTEL_QRK_I2C
	select SBA
	select I2C
	select INTEL_QRK_I2C
	select WAKELOCK
	select DEVICE_FRAMEWORK
	select NFC

config NFC_STN54E_TCMD
	bool "STN54E NFC test commands"
	depends on NFC_STN54E

menu "STN54E driver config"
	depends on NFC_STN54E

	config STN54E_I2C_ADDR
		hex "I2C address"
		default 0x08

	choice
		prompt "I2C bus"

	config NFC_STN54E_ON_I2C0
		bool "I2C0"

	config NFC_STN54E_ON_I2C1
		bool "I2C1"

	endchoice

	config STN54E_RST_PIN
		int "Reset pin"
		default 15

	config STN54E_IRQ_OUT_PIN
		int "IRQ_OUT pin"
		default 2

	config STN54E_HAS_PWR_EN
		bool "STN54E has power enable pin"
		default n

	config STN54E_PWR_EN_PIN
		int "Power enable pin"
		default 19
		depends on STN54E_HAS_PWR_EN

	config STN54E_HAS_BOOSTER
		bool "STN54E uses AS39230 RF booster chip"
		default n

	config STN54E_BOOSTER_RST_PIN
		int "RF booster reset pin"
		default 18
		depends on STN54E_HAS_BOOSTER

endmenu
```

## v2.0.0/device_software/intel_iq_sdk/wearable_device_sw/bsp/src/drivers/pm/Kconfig
```kconfig
config PM
	bool

config HAS_USB_PM
	bool

config WAKELOCK
	bool "Wakelock engine"
	help
		Generic Wakelock implementation for device drivers

config USB_PM
	bool "USB cable detection driver"
	depends on HAS_USB_PM
	depends on SOC_GPIO_AON || SOC_COMPARATOR
	select LIST

config USB_PM_SUSPEND_BLOCKERS
	bool "USB cable detection suspend blocker"
	default y
	depends on USB_PM
	help
		Prevent deepsleep mode if USB cable is plugged.

config BLE_CORE_SUSPEND_BLOCKER_PM
	bool "BLE Core suspend blocker driver"
	depends on HAS_BLE_CORE
	depends on PM
	depends on SOC_GPIO_AON

config HAS_PM_PUPDR
	bool

config PM_PUPDR
	bool "Power-Up Power-Down driver"
	depends on HAS_PM_PUPDR
	select DEVICE_FRAMEWORK
	select INTEL_QRK_RTC if HAS_INTEL_QRK_RTC
	select WAKELOCK
	select LIST

config HAS_BOARD_SHUTDOWN
	bool

config BOARD_SHUTDOWN
	bool "Call board specific shutdown and poweroff"
	depends on HAS_BOARD_SHUTDOWN
	depends on PM_PUPDR
	default y
```

## v2.0.0/device_software/intel_iq_sdk/wearable_device_sw/bsp/src/drivers/pwm/Kconfig
```kconfig
config HAS_INTEL_QRK_PWM
	bool

config INTEL_QRK_PWM
	bool "Intel Quark PWM driver"
	depends on HAS_INTEL_QRK_PWM
	select CLK_SYSTEM
```

## v2.0.0/device_software/intel_iq_sdk/wearable_device_sw/bsp/src/drivers/sensor/Kconfig
```kconfig
config SENSOR_BUS_COMMON
	bool

config HAS_BMI160
	bool

config HAS_BMI160_I2C
	bool
	select HAS_BMI160

config HAS_BMI160_SPI
	bool
	select HAS_BMI160

menu "BMI160 driver"
	config BMI160
		bool "BMI160 sensor driver"
		depends on (HAS_BMI160_I2C && HAS_SS_I2C) \
		        || (HAS_BMI160_SPI && HAS_SS_SPI)
		select SBA
		select SENSOR_BUS_COMMON
		select BMI160_I2C if HAS_BMI160_I2C
		select SS_I2C if HAS_BMI160_I2C
		select BMI160_SPI if HAS_BMI160_SPI
		select SS_SPI if HAS_BMI160_SPI
		select WORKQUEUE

	config BMM150
		bool "BMM150 compass sensor driver"
		depends on BMI160
		help
            Enable BMM150 support in BMI160 driver since BMM150 is supposed to
            connect to BMI160 and be managed by it.

	config BMI160_PM
		bool "BMI160 sensor power management"
		depends on BMI160
		default y
		select BMI160_BMI160_LOWPOWER_AVG

	config BMI160_ENABLE_DOUBLE_TAP
		bool "Enable bmi160 chip double tap detection"
		depends on BMI160
		default n

	config BMI160_LOWPOWER_AVG
		int "average cyling number"
		default 2
		depends on BMI160_PM
		help
			Control the average cycling number of bmi160 accelerometer
			in lowpower mode with undersampling enabled. The actual
			average cycling number equals to 2^BMI160_BMI160_LOWPOWER_AVG.

    config BMI160_LOWPOWER_AVG_NOMOTION
		int "average cyling number in nomiton"
		default 0
		depends on BMI160_PM
		help
			Control the average cycling number of bmi160 accelerometer
			in lowpower mode in nomotion state with undersampling enabled.
			The actual average cycling number equals to 2^BMI160_LOWPOWER_AVG_NOMOTION.

	config BMI160_DEFAULT_ACCEL_RANGE
		int "accelerometer sensing range"
		default 8
		depends on BMI160
		help
			Default sensing range of bmi160 accelerometer. The value can be 2, 4, 8, 16.
			So that bmi160 accelerometer sensing range can be +-2g, +-4g, +-8g, +-16g.

	config BMI160_CONVERT_ACCEL_DATA
		bool "convert accel data in mg"
		default y
		depends on BMI160
		help
			Convert accel sensor data in mg.

	config BMI160_DEFAULT_GYRO_RANGE
		int "gyro sensing range"
		default 1000
		depends on BMI160
		help
			Default sensing range of bmi160 gyro. The value can be 125, 250, 500, 1000, 2000.
			So that bmi160 gyro sensing range can be +-125 degree/s, +-250 degree/s, +-500 degree/s,
			+-1000 degree/s, +-2000 degree/s.

	config BMI160_CONVERT_GYRO_DATA
		bool "convert gyro data in millidegree/s"
		default y
		depends on BMI160
		help
			Convert accel sensor data in millidegree/s.
endmenu

config BMI160_I2C
	bool

config BMI160_SPI
	bool

config APDS9190
	bool "apds9190 IR proximity driver"
	depends on I2C
	depends on DEVICE_FRAMEWORK

config HAS_BME280
	bool

config HAS_BME280_I2C
	bool
	select HAS_BME280

config HAS_BME280_SPI
	bool
	select HAS_BME280

config BME280_I2C
	bool

config BME280_SPI
	bool

menu "BME280 driver"
	config BME280
		bool "BME280 sensor driver"
		depends on (HAS_BME280_I2C && HAS_SS_I2C) \
			    || (HAS_BME280_SPI && HAS_SS_SPI)
		select SBA
		select SENSOR_BUS_COMMON
		select BME280_I2C if HAS_BME280_I2C
		select SS_I2C if HAS_BME280_I2C
		select BME280_SPI if HAS_BME280_SPI
		select SS_SPI if HAS_BME280_SPI
		select INFRA
endmenu
```

## v2.0.0/device_software/intel_iq_sdk/wearable_device_sw/bsp/src/drivers/uart/Kconfig
```kconfig
config UART
	bool

config HAS_UART_NS16550
	bool

config UART_NS16550
	bool "UART NS16550"
	depends on HAS_UART_NS16550
	select UART

config UART_PM_NS16550
	bool "Zephyr NS16550 driver power management wrapper"
	depends on HAS_UART_NS16550
	depends on OS_ZEPHYR
	select DEVICE_FRAMEWORK
```
